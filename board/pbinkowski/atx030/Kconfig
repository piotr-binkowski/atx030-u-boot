## board/pbinkowski/atx030/Kconfig
```kconfig
if TARGET_ATX030

config SYS_CPU
	default "mc680x0"

config SYS_BOARD
	default "atx030"

config SYS_VENDOR
	default "pbinkowski"

config SYS_CONFIG_NAME
	default "ATX030"

endif
```

## board/pbinkowski/atx040/Kconfig
```kconfig
if TARGET_ATX040

config SYS_CPU
	default "mc680x0"

config SYS_BOARD
	default "atx040"

config SYS_VENDOR
	default "pbinkowski"

config SYS_CONFIG_NAME
	default "ATX040"

endif
```

## configs/ATX040_defconfig
```kconfig
CONFIG_M68K=y
CONFIG_SYS_TEXT_BASE=0x01F00000
CONFIG_TARGET_ATX040=y
CONFIG_NR_DRAM_BANKS=1
# CONFIG_SYS_MALLOC_CLEAR_ON_INIT is not set
# CONFIG_ARCH_FIXUP_FDT_MEMORY is not set
CONFIG_LOGLEVEL=8
CONFIG_HUSH_PARSER=y
CONFIG_SYS_PROMPT="> "
# CONFIG_CMD_BDI is not set
# CONFIG_CMD_CONSOLE is not set
# CONFIG_CMD_BOOTD is not set
CONFIG_CMD_BOOT68=y
# CONFIG_CMD_ELF is not set
# CONFIG_CMD_IMI is not set
# CONFIG_CMD_XIMG is not set
# CONFIG_CMD_EXPORTENV is not set
# CONFIG_CMD_IMPORTENV is not set
# CONFIG_CMD_EDITENV is not set
# CONFIG_CMD_ENV_EXISTS is not set
# CONFIG_CMD_CRC32 is not set
CONFIG_CMD_MEMTEST=y
CONFIG_SYS_ALT_MEMTEST=y
# CONFIG_CMD_LOADS is not set
CONFIG_CMD_MMC=y
CONFIG_CMD_MTD=y
CONFIG_CMD_MMC_SPI=y
CONFIG_CMD_PART=y
CONFIG_CMD_SPI=y
CONFIG_CMD_DHCP=y
# CONFIG_CMD_NFS is not set
# CONFIG_CMD_MISC is not set
CONFIG_CMD_EXT4=y
CONFIG_CMD_EXT4_WRITE=y
CONFIG_DOS_PARTITION=y
CONFIG_ENV_IS_IN_EXT4=y
CONFIG_ENV_EXT4_INTERFACE="mmc"
CONFIG_ENV_EXT4_DEVICE_AND_PART="0:1"
CONFIG_NET_RANDOM_ETHADDR=y
CONFIG_MMC=y
# CONFIG_MMC_HW_PARTITIONING is not set
CONFIG_ENC28J60=y
CONFIG_SPI=y
CONFIG_WB_SPI=y
# CONFIG_REGEX is not set
CONFIG_LZO=y
```
